## conf/layer.conf
```bitbake
# We have a conf and classes directory, add to BBPATH
BBPATH .= ":${LAYERDIR}"

# We have recipes-* directories, add to BBFILES
BBFILES += "${LAYERDIR}/recipes-*/*/*.bb \
	${LAYERDIR}/recipes-*/*/*.bbappend"

BBFILE_COLLECTIONS += "rauc"
BBFILE_PATTERN_rauc = "^${LAYERDIR}/"
BBFILE_PRIORITY_rauc = "6"

LAYERDEPENDS_rauc = "core"

# meta-python is needed to build/run hawkbit-client
LAYERRECOMMENDS_rauc = "meta-python"

# meta-filesystems is needed to build cascync with fuse support (the default)
LAYERRECOMMENDS_rauc += "meta-filesystems"

LAYERSERIES_COMPAT_rauc = "nanbield scarthgap"

# Sanity check for meta-rauc layer.
# Setting SKIP_META_RAUC_FEATURE_CHECK to "1" would skip the bbappend files check.
INHERIT += "sanity-meta-rauc"
```
